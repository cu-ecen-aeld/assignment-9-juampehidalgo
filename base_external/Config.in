## base_external/package/aesdsocket/Config.in
```kconfig
config BR2_PACKAGE_AESDSOCKET
	bool "aesdsoket"
	help
	  Includes the aesdsocket application as developed for assignment 5, part 1.
```

## base_external/package/ldd/Config.in
```kconfig
config BR2_PACKAGE_LDD
	bool "ldd"
	help
	  Linux driver development assignment (on Buildroot, obviously)
```
